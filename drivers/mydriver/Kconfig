## drivers/mydriver/Kconfig
```kconfig
menu "My Driver"
config MYDRIVER
    bool "my test driver"

if MYDRIVER
config MYDRIVER_HELLO
    tristate "hello world"
    help
        a simple driver test.
config MYDRIVER_PROCFS_TEST
    tristate "proc fs test"
    help
        a simple driver for proc fs test.
config MYDRIVER_SUBSYS_DEMO
    tristate "sub sys demo , proc sysfs."
    help
        a simple driver for sys demo.
endif
endmenu
```
